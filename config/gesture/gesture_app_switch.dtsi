/ {
  zip_mouse_gesture_app_sw: zip_mouse_gesture_app_sw {
    compatible = "zmk,input-processor-mouse-gesture";
    #input-processor-cells = <0>;
    enable-eager-mode;
    stroke-size = <5>;
    movement-threshold = <6>;
    idle-timeout-ms = <100>;
    gesture-cooldown-ms = <120>;

    app_prev { pattern = <GESTURE_LEFT>;  bindings = <&kp LS(TAB)>; };
    app_next { pattern = <GESTURE_RIGHT>; bindings = <&kp TAB>; };
  };
};
